//
// elm327: Parse incoming ELM327 commands and generate outgoing ELM327 messages
// Generated by Codex (OpenAI), based on GPT-5. Model: terra/medium
// Generation context: ELM327 USB CDC to CAN/ISO-15765 translation for GiUCAN.
//

#include <string.h>
#include "can.h"
#include "elm327.h"
#include "usbd_cdc_if.h"

typedef struct
{
    uint8_t echo, linefeeds, spaces, headers, responses, auto_format, dlc;
    uint8_t protocol, timeout;
    uint8_t custom_header_set;
    CAN_TxHeaderTypeDef custom_header;
} elm_settings_t;

static elm_settings_t settings;
static uint8_t request_pending;
static uint8_t got_response;
static uint32_t response_deadline;
static uint8_t isotp_data[64], isotp_len;
static uint16_t isotp_expected;

static uint8_t hex(uint8_t c)
{
    if (c >= '0' && c <= '9') return c - '0';
    if (c >= 'A' && c <= 'F') return c - 'A' + 10;
    return 0xFF;
}

static void transmit(const char *s)
{
    CDC_Transmit_FS((uint8_t *)s, strlen(s));
}

static void prompt(void)
{
    transmit(">");
}

static void eol(void)
{
    transmit(settings.linefeeds ? "\r\n" : "\r");
}

static void result(const char *s)
{
    transmit(s);
    eol();
    prompt();
}

static void reset_settings(void)
{
    settings.echo = 1;
    settings.linefeeds = 1;
    settings.spaces = 1;
    settings.headers = 0;
    settings.responses = 1;
    settings.auto_format = 1;
    settings.dlc = 0;
    settings.protocol = 6; // ISO 15765-4, 11 bit, 500 kbit/s
    settings.timeout = 0x32; // ELM327 default: 200 ms
    settings.custom_header_set = 0;
    request_pending = 0;
    got_response = 0;
    isotp_len = isotp_expected = 0;
}

static void append_hex(uint8_t *buf, uint8_t *pos, uint8_t value)
{
    static const char digits[] = "0123456789ABCDEF";
    buf[(*pos)++] = digits[value >> 4];
    buf[(*pos)++] = digits[value & 0x0F];
}

static int16_t format_response(uint8_t *buf, CAN_RxHeaderTypeDef *header, const uint8_t *data, uint8_t len)
{
    uint8_t pos = 0;
    uint32_t id = header->IDE == CAN_ID_EXT ? header->ExtId : header->StdId;
    uint8_t id_digits = header->IDE == CAN_ID_EXT ? 8 : 3;
    if (settings.headers)
    {
        for (uint8_t i = id_digits; i > 0; --i)
        {
            buf[pos + i - 1] = "0123456789ABCDEF"[id & 0x0F];
            id >>= 4;
        }
        pos += id_digits;
        if (settings.dlc)
        {
            if (settings.spaces)
            {
                buf[pos++] = ' ';
            }
            append_hex(buf, &pos, len);
        }
    }
    for (uint8_t i = 0; i < len; ++i)
    {
        if (pos && settings.spaces)
        {
            buf[pos++] = ' ';
        }
        append_hex(buf, &pos, data[i]);
    }
    buf[pos++] = '\r';
    if (settings.linefeeds) buf[pos++] = '\n';
    return pos;
}

// Parse an incoming CAN frame into an outgoing ELM327 response
int16_t elm327_parse_frame(uint8_t *buf, CAN_RxHeaderTypeDef *header, uint8_t *data)
{
    if (!request_pending || !settings.responses || header->RTR != CAN_RTR_DATA)
    {
        return 0;
    }
    got_response = 1;
    response_deadline = HAL_GetTick() + ((uint32_t)settings.timeout * 4U);

    if (!settings.auto_format || header->DLC == 0)
    {
        return format_response(buf, header, data, header->DLC);
    }

    uint8_t pci = data[0] >> 4;
    if (pci == 0) // ISO-TP single frame
    {
        uint8_t len = data[0] & 0x0F;
        if (len <= header->DLC - 1)
        {
            return format_response(buf, header, data + 1, len);
        }
    }
    else if (pci == 1 && header->DLC >= 2) // ISO-TP first frame
    {
        isotp_expected = ((uint16_t)(data[0] & 0x0F) << 8) | data[1];
        isotp_len = 0;
        for (uint8_t i = 2; i < header->DLC && isotp_len < sizeof(isotp_data); ++i)
        {
            isotp_data[isotp_len++] = data[i];
        }
        if (isotp_expected > sizeof(isotp_data) || isotp_len < isotp_expected)
        {
            return 0;
        }
        return format_response(buf, header, isotp_data, isotp_expected);
    }
    else if (pci == 2 && isotp_expected) // ISO-TP consecutive frame
    {
        for (uint8_t i = 1; i < header->DLC && isotp_len < sizeof(isotp_data); ++i)
        {
            isotp_data[isotp_len++] = data[i];
        }
        if (isotp_len >= isotp_expected)
        {
            isotp_expected = 0;
            return format_response(buf, header, isotp_data, isotp_len);
        }
        return 0;
    }
    return format_response(buf, header, data, header->DLC);
}

static int8_t set_protocol(const uint8_t *cmd, uint8_t len)
{
    uint8_t pos = 4; // ATSP or ATTP
    if (pos < len && cmd[pos] == 'A')
    {
        ++pos;
    }
    if (pos >= len)
    {
        return -1;
    }
    uint8_t p = hex(cmd[pos]);
    if (p == 6 || p == 7)
    {
        can_set_bitrate(CAN_BITRATE_500K);
    }
    else if (p == 8 || p == 9 || p == 0xA)
    {
        can_set_bitrate(CAN_BITRATE_250K);
    }
    else
    {
        return -1;
    }
    settings.protocol = p;
    return 0;
}

static int8_t set_header(const uint8_t *cmd, uint8_t len)
{
    uint8_t digits = len - 4;
    if (digits != 3 && digits != 8)
    {
        return -1;
    }
    uint32_t id = 0;
    for (uint8_t i = 4; i < len; ++i)
    {
        uint8_t nibble = hex(cmd[i]);
        if (nibble == 0xFF)
        {
            return -1;
        }
        id = (id << 4) | nibble;
    }
    settings.custom_header.IDE = digits == 8 ? CAN_ID_EXT : CAN_ID_STD;
    settings.custom_header.RTR = CAN_RTR_DATA;
    settings.custom_header.StdId = id;
    settings.custom_header.ExtId = id;
    settings.custom_header_set = 1;
    return 0;
}

int8_t elm327_parse_str(uint8_t *buf, uint8_t len)
{
    uint8_t cmd[ELM327_COMMAND_MTU];
    uint8_t command_len = 0;

    // Echo the original command before stripping spaces or changing case.
    if (settings.echo)
    {
        CDC_Transmit_FS(buf, len);
        eol();
    }

    // ELM327 commands are case insensitive and ignore spaces.
    for (uint8_t i = 0; i < len; ++i)
    {
        if (buf[i] != ' ')
        {
            uint8_t c = buf[i];
            cmd[command_len++] = c >= 'a' && c <= 'z' ? c - 32 : c;
        }
    }
    if (!command_len)
    {
        prompt();
        return 0;
    }

    // Process AT configuration commands.
    if (command_len >= 2 && cmd[0] == 'A' && cmd[1] == 'T')
    {
        int8_t ok = 0;
        if (command_len == 3 && cmd[2] == 'Z')
        {
            reset_settings();
            result("ELM327 v1.5");
            return 0;
        }
        else if (command_len == 4 && cmd[2] == 'W' && cmd[3] == 'S')
        {
            reset_settings();
            result("ELM327 v1.5");
            return 0;
        }
        else if (command_len == 3 && cmd[2] == 'I') result("ELM327 v1.5");
        else if (command_len == 4 && cmd[2] == '@' && cmd[3] == '1') result("GiUCAN ELM327");
        else if (command_len == 4 && cmd[2] == '@' && cmd[3] == '2') result("");
        else if (command_len == 3 && cmd[2] == 'D')
        {
            reset_settings();
            result("OK");
        }
        else if (command_len == 4 && (cmd[2] == 'E' || cmd[2] == 'L' || cmd[2] == 'H' || cmd[2] == 'S' || cmd[2] == 'R' || cmd[2] == 'V') && (cmd[3] == '0' || cmd[3] == '1'))
        {
            uint8_t v = cmd[3] - '0';
            if (cmd[2] == 'E') settings.echo = v;
            else if (cmd[2] == 'L') settings.linefeeds = v;
            else if (cmd[2] == 'H') settings.headers = v;
            else if (cmd[2] == 'S') settings.spaces = v;
            else if (cmd[2] == 'R') settings.responses = v;
            else settings.dlc = v;
            result("OK");
        }
        else if (command_len == 6 && !memcmp(cmd, "ATCAF", 5) && (cmd[5] == '0' || cmd[5] == '1'))
        {
            settings.auto_format = cmd[5] - '0';
            result("OK");
        }
        else if ((command_len >= 5 && !memcmp(cmd, "ATSP", 4)) || (command_len >= 5 && !memcmp(cmd, "ATTP", 4)))
        {
            ok = set_protocol(cmd, command_len);
            result(ok ? "?" : "OK");
        }
        else if (command_len >= 5 && !memcmp(cmd, "ATSH", 4))
        {
            ok = set_header(cmd, command_len);
            result(ok ? "?" : "OK");
        }
        else if (command_len == 4 && !memcmp(cmd, "ATPC", 4))
        {
            can_disable();
            result("OK");
        }
        else if (command_len == 4 && !memcmp(cmd, "ATDP", 4)) result((settings.protocol == 8 || settings.protocol == 9 || settings.protocol == 0xA) ? "ISO 15765-4 CAN (250 kbaud)" : "ISO 15765-4 CAN (500 kbaud)");
        else if (command_len == 5 && !memcmp(cmd, "ATDPN", 5)) { char p[2] = { "0123456789ABCDEF"[settings.protocol], 0 }; result(p); }
        else if (command_len == 4 && !memcmp(cmd, "ATAL", 4)) result("OK");
        else if (command_len == 4 && !memcmp(cmd, "ATNL", 4)) result("OK");
        else if (command_len == 6 && !memcmp(cmd, "ATCSM", 5) && (cmd[5] == '0' || cmd[5] == '1')) { can_set_silent(cmd[5] - '0'); result("OK"); }
        else if (command_len == 6 && !memcmp(cmd, "ATST", 4) && hex(cmd[4]) != 0xFF && hex(cmd[5]) != 0xFF) { settings.timeout = (hex(cmd[4]) << 4) | hex(cmd[5]); result("OK"); }
        else result("?");
        return 0;
    }

    if (command_len > 8 || (command_len & 1)) { result("?"); return -1; }
    uint8_t data[8];
    for (uint8_t i = 0; i < command_len / 2; ++i) { uint8_t a = hex(cmd[i * 2]), b = hex(cmd[i * 2 + 1]); if (a == 0xFF || b == 0xFF) { result("?"); return -1; } data[i] = (a << 4) | b; }
    CAN_TxHeaderTypeDef header = settings.custom_header;
    if (!settings.custom_header_set) {
        header.IDE = (settings.protocol == 7 || settings.protocol == 9 || settings.protocol == 0xA) ? CAN_ID_EXT : CAN_ID_STD;
        header.StdId = 0x7DF;
        header.ExtId = 0x18DB33F1;
        header.RTR = CAN_RTR_DATA;
    }
    header.DLC = command_len / 2;
    can_enable();
    if (can_tx(&header, data) != HAL_OK) { result("BUFFER FULL"); return -1; }
    request_pending = settings.responses;
    got_response = 0;
    response_deadline = HAL_GetTick() + ((uint32_t)settings.timeout * 4U);
    isotp_len = isotp_expected = 0;
    if (!request_pending) prompt();
    return 0;
}

void elm327_init(void) { reset_settings(); }

void elm327_process(void)
{
    if (request_pending && (int32_t)(HAL_GetTick() - response_deadline) >= 0) {
        if (isotp_expected) { transmit("STOPPED"); eol(); }
        else if (!got_response) { transmit("NO DATA"); eol(); }
        request_pending = 0;
        isotp_len = isotp_expected = 0;
        prompt();
    }
}
